#include "ObjectSpinDocument.h"

#include <wx/xml/xml.h>
#include <wx/stdpaths.h>
#include "ObjectSpinApp.h"

IMPLEMENT_DYNAMIC_CLASS(ObjectSpinDocument, wxDocument)

wxInputStream& ObjectSpinDocument::LoadObject(wxInputStream& stream)
{
    wxDocument::LoadObject(stream);

    wxLogMessage(wxT("Loading document: ") + GetFilename());

    // change the working directory to the location of the file
    wxSetWorkingDirectory(wxPathOnly(GetFilename()));

    wxXmlDocument doc(stream);
    if (doc.IsOk() && doc.GetRoot() && doc.GetRoot()->GetName() == wxT("spin_project"))
    {
        wxXmlNode* root = doc.GetRoot();
        if (root->GetPropVal(wxT("version"), wxT("")) != wxT("1"))
		{
			LogWarning(_("This project was generated by a newer version of Turn Table, and may not load correctly."));
		}
		wxXmlNode* node = root->GetChildren();
		while (node)
		{
			if (node->GetName() == wxT("images"))
			{
				GetImageStack()->Deserialize(node);
			}
			else if (node->GetName() == wxT("crop"))
			{
				GetImageStack()->DeserializeCrop(node);
			}
			else if (node->GetName() == wxT("watermark"))
			{
				GetImageStack()->DeserializeWatermark(node);
			}
			else if (node->GetName() == wxT("export"))
			{
				GetMainFrame()->GetExportSettingsPanel()->Deserialize(node);
				GetMainFrame()->GetExportSettingsPanel()->UpdateAspectLabel();
			}
			else if (node->GetName() == wxT("histogram"))
			{
				GetMainFrame()->GetHistogramPanel()->Deserialize(node);
			}
			else LogMessage(wxT("Unknown node '") + node->GetName() + wxT("' while reading file."));
			node = node->GetNext();
		}
		GetMainFrame()->GetExportSettingsPanel()->UpdateAspectLabel();
    }
    else wxLogError(wxT("'") + GetFilename() + wxT("' is corrupt or not a known project file."));

    return stream;
}

wxOutputStream& ObjectSpinDocument::SaveObject(wxOutputStream& stream)
{
    wxDocument::SaveObject(stream);

    wxString srcPath = wxFileName::GetCwd();
    wxString dstPath = wxFileName::FileName(GetFilename()).GetPath();

    wxLogMessage(wxT("Saving document: ") + GetFilename());
    //wxLogMessage(wxT("From: ") + srcPath + wxT(" To: ") + dstPath);

    if(!srcPath.IsSameAs(dstPath)) { // when saving as to a different folder, copy images
        for(unsigned i = 0; i < GetImageStack()->GetNumImages(); i++) {
            if(GetImageStack()->GetImage(i) != AnnotatedImage::Ptr()) {
                AnnotatedImage::Ptr image = GetImageStack()->GetImage(i);
                //wxLogMessage(wxT("Image: ") + image->GetFileName());
                wxCopyFile(srcPath + wxFileName::GetPathSeparator() + image->GetFileName(), dstPath + wxFileName::GetPathSeparator() + image->GetFileName());
            }
        }
        wxSetWorkingDirectory(dstPath);
    }

    wxXmlDocument doc;
    wxXmlNode* root = new wxXmlNode(wxXML_ELEMENT_NODE, wxT("spin_project"));
    root->AddProperty(wxT("version"), wxT("1"));
    doc.SetRoot(root);
    GetImageStack()->Serialize(root);
	GetMainFrame()->GetHistogramPanel()->Serialize(root);
	GetMainFrame()->GetExportSettingsPanel()->Serialize(root);
	GetImageStack()->SerializeWatermark(root);
	GetImageStack()->SerializeCrop(root);
    doc.Save(stream);

    return stream;
}
